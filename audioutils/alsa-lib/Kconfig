## audioutils/alsa-lib/Kconfig
```kconfig
#
# For a description of the syntax of this configuration file,
# see the file kconfig-language.txt in the NuttX tools repository.
#

config AUDIOUTILS_ALSA_LIB
	bool "Enable ALSA lib"
	default n

if AUDIOUTILS_ALSA_LIB

config AUDIOUTILS_ALSA_LIB_DEV_PATH
	string "play/recored device path"
	default "/dev/audio"

choice
	prompt "Alsa Playback Device to be used"
	default AUDIOUTILS_ALSA_LIB_DEVICE_HW

config AUDIOUTILS_ALSA_LIB_DEVICE_HW
	bool "Use hardware device(not support mix, more faster)"

endchoice # Alsa lib Device

choice
	prompt "Alsa LOG Output Controls"
	default AUDIOUTILS_ALSA_LIB_LOG_INFO

config AUDIOUTILS_ALSA_LIB_LOG_DEBUG
	bool "Output DEBUG+ log"

config AUDIOUTILS_ALSA_LIB_LOG_INFO
	bool "Output INFO+ log"

config AUDIOUTILS_ALSA_LIB_LOG_WARN
	bool "Output WARN+ log"

config AUDIOUTILS_ALSA_LIB_LOG_ERR
	bool "Output ERROR+ log"

endchoice # Alsa LOG Output Controls

config AUDIOUTILS_ALSA_LIB_APLAY
	bool "alsa aplay"
	default n

config AUDIOUTILS_ALSA_LIB_ARECORD
	bool "alsa arecord"
	default n

endif # AUDIOUTILS_ALSA_LIB
```

## examples/atomic/Kconfig
```kconfig
#
# For a description of the syntax of this configuration file,
# see the file kconfig-language.txt in the NuttX tools repository.
#

config EXAMPLES_ATOMIC
	tristate "\"Test atomic\" example"
	default n
	---help---
		Enable the \"Test atomic!\" example

if EXAMPLES_ATOMIC

config EXAMPLES_ATOMIC_PROGNAME
	string "Program name"
	default "atomic"
	---help---
		This is the name of the program that will be used when the NSH ELF
		program is atomic.

config EXAMPLES_ATOMIC_PRIORITY
	int "Atomic task priority"
	default 100

config EXAMPLES_ATOMIC_STACKSIZE
	int "Atomic stack size"
	default DEFAULT_TASK_STACKSIZE

endif
```

## graphics/lvgl/Kconfig
```kconfig
#
# For a description of the syntax of this configuration file,
# see the file kconfig-language.txt in the NuttX tools repository.
#

menuconfig GRAPHICS_LVGL
	bool "Light and Versatile Graphic Library (LVGL)"
	default n
	---help---
		Enable support for the LVGL GUI library.

if GRAPHICS_LVGL

config LVGL_VERSION
	string "LVGL Version"
	default "9.1.0"

osource "$APPSDIR/graphics/lvgl/lvgl/Kconfig"
osource "$APPSDIR/graphics/lvgl/ext/Kconfig"

config LV_DRAW_VG_LITE_INCLUDE
	string "VG-Lite API header include path"
	depends on LV_USE_DRAW_VG_LITE
	default ""

config LV_GPU_G2D_INCLUDE_PATH
	string "include path of G2D header"
	depends on LV_USE_DRAW_G2D
	default ""

config LV_OPTLEVEL
	string "Customize compilation optimization level"
	default ""

endif # GRAPHICS_LVGL
```

## graphics/lvgl/lv_demos/Kconfig
```kconfig
#
# For a description of the syntax of this configuration file,
# see the file kconfig-language.txt in the NuttX tools repository.
#

menuconfig LV_DEMOS
	bool "Enable LVGL Native Demos Entry"
	default n
	---help---
		Enable LVGL Native Demos Entry

if LV_DEMOS
config LV_DEMOS_PRIORITY
	int "LVGL demos entry task priority"
	default 100

config LV_DEMOS_STACKSIZE
	int "LVGL demos entry stack size"
	default DEFAULT_TASK_STACKSIZE
endif
```

## netutils/libwebsockets/Kconfig
```kconfig
#
# For a description of the syntax of this configuration file,
# see the file kconfig-language.txt in the NuttX tools repository.
#

config NETUTILS_LIBWEBSOCKETS
	bool "libwebsockets library (current version)"
	default n
	depends on NET && OPENSSL_MBEDTLS_WRAPPER
	---help---
		Enables the libwebsockets library.

if NETUTILS_LIBWEBSOCKETS

config NETUTILS_LIBWEBSOCKETS_VERSION
	string "Version number"
	default "4.3.1"

config NETUTILS_LIBWEBSOCKETS_CERTS
	string "Libwebsocket Certificate Authorize Path"
	default "/etc/ssl/curl"
	depends on CRYPTO_MBEDTLS

endif
```

## testing/devicetree/api/Kconfig
```kconfig
#
# For a description of the syntax of this configuration file,
# see the file kconfig-language.txt in the NuttX tools repository.
#

config TESTING_DEVICETREE
	tristate "vela cmocka devicetree test"
	default n
	depends on TESTING_CMOCKA
	---help---
		Enable the cmocka devicetree test

if TESTING_DEVICETREE

config TESTING_DEVICETREE_PRIORITY
	int "Task priority"
	default 100

config TESTING_DEVICETREE_STACKSIZE
	int "Stack size"
	default DEFAULT_TASK_STACKSIZE

config TESTING_DEVICETREE_OVERLAY_FILE
	string "overlay file name"
	default "app.overlay"

endif
```

## wireless/bluetooth/nimble/Kconfig
```kconfig
config NIMBLE
	bool "Apache nimBLE (BLE host-layer)"
	default n
	depends on !WIRELESS_BLUETOOTH_HOST
	---help---
		Enable Apache nimBLE Bluetooth Low Energy
		host-layer stack.

if NIMBLE

config NIMBLE_REF
	string "Version"
	default "17a8e61fdec48d579df3bc5af59a9cff5edee674"
	---help---
		Git ref name to use when downloading from nimBLE repo

config NIMBLE_PORTING_EXAMPLE
	bool "Apache nimBLE NuttX porting example"
	default y

if NIMBLE_PORTING_EXAMPLE

config NIMBLE_PORTING_EXAMPLE_STACKSIZE
	int "Apache NimBLE NuttX porting example stack size"
	default DEFAULT_TASK_STACKSIZE

endif # NIMBLE_PORTING_EXAMPLE

endif # NIMBLE
```
